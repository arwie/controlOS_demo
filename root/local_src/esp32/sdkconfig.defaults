## root/local_src/esp32/sdkconfig.defaults
```kconfig
CONFIG_PARTITION_TABLE_CUSTOM=y
CONFIG_PARTITION_TABLE_CUSTOM_FILENAME="../partitions.csv"
CONFIG_ESPTOOLPY_FLASHSIZE_4MB=y

CONFIG_APP_RETRIEVE_LEN_ELF_SHA=32

# CONFIG_ESP_PHY_CALIBRATION_AND_DATA_STORAGE is not set
# CONFIG_ESP32_WIFI_NVS_ENABLED is not set
# CONFIG_ESP_WIFI_SOFTAP_SUPPORT is not set
```
